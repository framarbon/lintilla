#include "lintilla.dtsi"
#include "lintilla_kscan.dtsi"

&left_encoder {
    status = "okay";
};

/ {
    aliases {
        led-red = &led0;
        led-green = &led1;
        led-blue = &led2;
    };
};

// vim: expandtab softtabstop=4 shiftwidth=4 filetype=devicetree
